## drivers/sensor/ens160/Kconfig
```kconfig
menuconfig ENS160
	bool "ENS160 Digital Temperature and Humidity sensor"
	default y
	depends on DT_HAS_AMS_ENS160_ENABLED
	select I2C
	help
	  Enable driver for ENS160 Digital Temperature and Humidity sensor.
```

## dts/bindings/sensor/ams,ens160.yaml
```yaml
description: |
    AMS ens210 Relative Humidity and Temperature Sensor

compatible: "ams,ens210"

include: [sensor-device.yaml, i2c-device.yaml]
```
